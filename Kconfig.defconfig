## Kconfig.defconfig
```kconfig
if SHIELD_SP40_LEFT

config ZMK_KEYBOARD_NAME
    default "SP40 Left"

endif

if SHIELD_SP40_RIGHT

config ZMK_KEYBOARD_NAME
    default "SP40 Right"

endif
```

## config/boards/shields/sp40/Kconfig.defconfig
```kconfig
if SHIELD_SP40_LEFT

config ZMK_KEYBOARD_NAME
    default "SP40 Left"

config ZMK_SPLIT_ROLE_CENTRAL
    default y

endif

if SHIELD_SP40_RIGHT

config ZMK_KEYBOARD_NAME
    default "SP40 Right"

config ZMK_SPLIT_ROLE_CENTRAL
    default n

endif

if SHIELD_SP40_LEFT || SHIELD_SP40_RIGHT

config ZMK_SPLIT
    default y

endif
```

## config/boards/shields/sp40/Kconfig.shield
```kconfig
config SHIELD_SP40_LEFT
    def_bool $(shields_list_contains,sp40_left)

config SHIELD_SP40_RIGHT
    def_bool $(shields_list_contains,sp40_right)
```
